#include "sweeq.dtsi"

&kscan0 {
    col-gpios
        = <&pro_micro 21 GPIO_ACTIVE_HIGH>
        , <&pro_micro 20 GPIO_ACTIVE_HIGH>
        , <&pro_micro 19 GPIO_ACTIVE_HIGH>
        , <&pro_micro 18 GPIO_ACTIVE_HIGH>
        , <&pro_micro 15 GPIO_ACTIVE_HIGH>
        ;
};

&glidepoint_listener {
    status = "okay";

    scroller {
        layers = <4>;
        input-processors
            = <&zip_xy_scaler 1 42>
            , <&zip_xy_to_scroll_mapper>
            ;
    };
};
