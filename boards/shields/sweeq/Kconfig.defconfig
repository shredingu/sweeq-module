## boards/shields/sweeq/Kconfig.defconfig
```kconfig
if SHIELD_SWEEQ_LEFT

config ZMK_KEYBOARD_NAME
    default "holykeebs sweeq"

config ZMK_SPLIT_ROLE_CENTRAL
    default y

endif # SHIELD_SWEEQ_LEFT

if SHIELD_SWEEQ_LEFT || SHIELD_SWEEQ_RIGHT

config ZMK_SPLIT
    default y

config ZMK_POINTING
    default y
# config ZMK_DISPLAY
# 
# if ZMK_DISPLAY
# 
# config SSD1306
#     default y
# 
# 
# endif # ZMK_DISPLAY
# 
# if LVGL
# 
# config LV_Z_VDB_SIZE
#     default 64
# 
# config LV_DPI_DEF
#     default 148
# 
# config LV_Z_BITS_PER_PIXEL
#     default 1
# 
# choice LV_COLOR_DEPTH
#     default LV_COLOR_DEPTH_1
# endchoice
# 
# endif # LVGL

endif # SHIELD_SWEEQ_LEFT || SHIELD_SWEEQ_RIGHT

if SHIELD_SWEEQ_RIGHT
    # Left side of sweeq has the touchpad 
    config I2C
        default y
endif
```

## config/west.yml
```yaml
manifest:
  remotes:
    - name: zmkfirmware
      url-base: https://github.com/zmkfirmware
    # Additional modules containing boards/shields/custom code can be listed here as well
    # See https://docs.zephyrproject.org/3.2.0/develop/west/manifest.html#projects
    - name: shredingu
      url-base: https://github.com/shredingu
  projects:
    - name: zmk
      remote: zmkfirmware
      revision: main
      import: app/west.yml
    - name: cirque-input-module
      remote: shredingu
      revision: main
  self:
    path: config
```
